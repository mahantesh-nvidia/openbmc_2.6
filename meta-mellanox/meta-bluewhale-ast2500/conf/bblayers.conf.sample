## meta-mellanox/meta-bluewhale-ast2500/conf/bblayers.conf.sample
```bitbake
# LAYER_CONF_VERSION is increased each time build/conf/bblayers.conf
# changes incompatibly
LCONF_VERSION = "8"

BBPATH = "${TOPDIR}"
BBFILES ?= ""

BBLAYERS ?= " \
  ##OEROOT##/meta \
  ##OEROOT##/meta-poky \
  ##OEROOT##/meta-openembedded/meta-oe \
  ##OEROOT##/meta-openembedded/meta-networking \
  ##OEROOT##/meta-openembedded/meta-filesystems \
  ##OEROOT##/meta-openembedded/meta-python \
  ##OEROOT##/meta-phosphor \
  ##OEROOT##/meta-aspeed \
  ##OEROOT##/meta-mellanox \
  ##OEROOT##/meta-mellanox/meta-bluewhale-ast2500 \
  "
BBLAYERS_NON_REMOVABLE ?= " \
  ##OEROOT##/meta \
  ##OEROOT##/meta-poky \
  ##OEROOT##/meta-openembedded/meta-oe \
  ##OEROOT##/meta-openembedded/meta-networking \
  ##OEROOT##/meta-openembedded/meta-filesystems \
  ##OEROOT##/meta-openembedded/meta-python \
  ##OEROOT##/meta-phosphor \
  ##OEROOT##/meta-aspeed \
  ##OEROOT##/meta-mellanox \
  ##OEROOT##/meta-mellanox/meta-bluewhale-ast2500 \
  "
```

## meta-mellanox/meta-bluewhale-ast2500/conf/machine/bluewhale-ast2500.conf
```bitbake
KMACHINE = "aspeed"
KERNEL_DEVICETREE = "aspeed-bmc-mlx-bluewhale.dtb aspeed-bmc-mlx-bluetang.dtb aspeed-bmc-mlx-bluewhale2u.dtb"
KERNEL_IMAGETYPE = "uImage"
KERNEL_EXTRA_ARGS += "LOADADDR=0x80001000"

# Manipulate the DISTRO_NAME variable string for our needs
DISTRO_NAME_remove = "Phosphor"
DISTRO_NAME_remove = "OpenBMC"
DISTRO_NAME_remove = "(Phosphor"
DISTRO_NAME_prepend = "Mellanox BMC (OpenBMC "

# Declare offsets (in KB) of each flash partition
FLASH_UBOOT_OFFSET = "0"
FLASH_KERNEL_OFFSET = "448"
FLASH_ROFS_OFFSET = "5376"
FLASH_RWFS_OFFSET = "28672"

UBOOT_MACHINE = "mlnxast2500bmc_config"

MACHINE_EXTRA_RDEPENDS = "kernel-modules u-boot-fw-utils-aspeed"

require conf/machine/include/ast2500.inc
require conf/machine/include/obmc-bsp-common.inc

OBMC_MACHINE_FEATURES += "\
        obmc-phosphor-system-mgmt \
        "

#VIRTUAL-RUNTIME_skeleton_workbook = "${MACHINE}-config"

PREFERRED_PROVIDER_virtual/obmc-system-mgmt = "packagegroup-bf-apps"
```
